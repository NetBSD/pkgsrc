## sysutils/u-boot/patches-2022.01/patch-configs_nanopi-r4s-rk3399_defconfig
```kconfig
$NetBSD: patch-configs_nanopi-r4s-rk3399_defconfig,v 1.1 2025/12/13 01:10:23 gutteridge Exp $

Load u-boot from 256KB.

--- configs/nanopi-r4s-rk3399_defconfig.orig	2022-01-10 13:46:34.000000000 -0500
+++ configs/nanopi-r4s-rk3399_defconfig
@@ -1,6 +1,7 @@
 CONFIG_ARM=y
 CONFIG_SKIP_LOWLEVEL_INIT=y
 CONFIG_ARCH_ROCKCHIP=y
+CONFIG_SYS_MMCSD_RAW_MODE_U_BOOT_SECTOR=0x200
 CONFIG_SYS_TEXT_BASE=0x00200000
 CONFIG_NR_DRAM_BANKS=1
 CONFIG_ENV_OFFSET=0x3F8000
```

## sysutils/u-boot/patches-2024.10/patch-configs_legoev3__defconfig
```kconfig
$NetBSD: patch-configs_legoev3__defconfig,v 1.1 2026/09/10 20:03:41 yurix Exp $

Move the location in memory where u-boot runs to avoid corrupting the stage 1
u-boot.

--- configs/legoev3_defconfig.orig	2026-09-10 17:05:26.038961199 +0000
+++ configs/legoev3_defconfig
@@ -1,7 +1,7 @@
 CONFIG_ARM=y
 CONFIG_SKIP_LOWLEVEL_INIT=y
 CONFIG_ARCH_DAVINCI=y
-CONFIG_TEXT_BASE=0xc1080000
+CONFIG_TEXT_BASE=0xc10c0000
 CONFIG_SYS_MALLOC_LEN=0x110000
 CONFIG_SYS_MALLOC_F_LEN=0x400
 CONFIG_TARGET_LEGOEV3=y
```
