## net/wpa_supplicant/files/defconfig
```kconfig
# Enable these default wpa_supplicant build options
CONFIG_CTRL_IFACE=y
CONFIG_DRIVER_WIRED=y
CONFIG_EAP_GTC=y
CONFIG_EAP_MD5=y
CONFIG_EAP_OTP=y
CONFIG_EAP_PAX=y
CONFIG_EAP_PSK=y
CONFIG_EAP_TLV=y
CONFIG_IEEE8021X_EAPOL=y
CONFIG_PKCS12=y
CONFIG_PEERKEY=y
CONFIG_EAP_LEAP=y
CONFIG_EAP_MSCHAPV2=y
CONFIG_EAP_PEAP=y
CONFIG_EAP_TLS=y
CONFIG_EAP_TTLS=y
CONFIG_TLS=openssl
CONFIG_SMARTCARD=y
```

## sysutils/u-boot-pocketchip/files/PocketCHIP_defconfig
```kconfig
CONFIG_ARM=y
CONFIG_ARCH_SUNXI=y
CONFIG_MACH_SUN5I=y
CONFIG_DRAM_TIMINGS_DDR3_800E_1066G_1333J=y
CONFIG_USB0_VBUS_PIN="PB10"
CONFIG_VIDEO_COMPOSITE=y
CONFIG_DEFAULT_DEVICE_TREE="sun5i-r8-chip"
CONFIG_SPL=y
CONFIG_SPL_I2C_SUPPORT=y
# CONFIG_CMD_IMLS is not set
CONFIG_CMD_DFU=y
CONFIG_CMD_USB_MASS_STORAGE=y
# CONFIG_SPL_DOS_PARTITION is not set
# CONFIG_SPL_ISO_PARTITION is not set
# CONFIG_SPL_EFI_PARTITION is not set
CONFIG_DFU_RAM=y
# CONFIG_MMC is not set
CONFIG_AXP_ALDO3_VOLT=3300
CONFIG_AXP_ALDO4_VOLT=3300
CONFIG_USB_EHCI_HCD=y
CONFIG_USB_MUSB_GADGET=y
CONFIG_USB_GADGET=y
CONFIG_USB_GADGET_DOWNLOAD=y
CONFIG_G_DNL_MANUFACTURER="Allwinner Technology"
CONFIG_G_DNL_VENDOR_NUM=0x1f3a
CONFIG_G_DNL_PRODUCT_NUM=0x1010
CONFIG_OF_LIBFDT_OVERLAY=y

CONFIG_I2C1_ENABLE=y
CONFIG_AXP_GPIO=y
CONFIG_VIDEO=y
CONFIG_VIDEO_VGA_VIA_LCD=y
CONFIG_VIDEO_LCD_MODE="x:480,y:272,depth:18,pclk_khz:9000,le:10,ri:5,up:3,lo:8,hs:30,vs:5,sync:3,vmode:0"
CONFIG_VIDEO_LCD_POWER="AXP0-1"
CONFIG_VIDEO_LCD_BL_EN="PD18"
CONFIG_VIDEO_LCD_BL_PWM="PB2"
CONFIG_VIDEO_CHRONTEL_CH7033=y
CONFIG_VIDEO_CHRONTEL_CH7033_I2C_BUS=1
```

## sysutils/u-boot/patches-2020.01-rc5/patch-configs_rock64-rk3328_defconfig
```kconfig
$NetBSD: patch-configs_rock64-rk3328_defconfig,v 1.1 2021/04/18 08:54:55 mrg Exp $

Put u-boot at 256KB.

--- configs/rock64-rk3328_defconfig.orig	2019-12-16 04:39:56.000000000 -0800
+++ configs/rock64-rk3328_defconfig	2020-01-09 12:47:03.348721688 -0800
@@ -1,6 +1,7 @@
 CONFIG_ARM=y
 CONFIG_ARCH_ROCKCHIP=y
 CONFIG_SYS_TEXT_BASE=0x00200000
+CONFIG_SYS_MMCSD_RAW_MODE_U_BOOT_SECTOR=0x200
 CONFIG_ROCKCHIP_RK3328=y
 CONFIG_TPL_ROCKCHIP_COMMON_BOARD=y
 CONFIG_TPL_LIBCOMMON_SUPPORT=y
```

## sysutils/u-boot/patches-2021.07/patch-configs_pinebook-pro-rk3399_defconfig
```kconfig
$NetBSD: patch-configs_pinebook-pro-rk3399_defconfig,v 1.1 2021/07/26 06:36:41 mrg Exp $

Load u-boot from 256KB.

--- configs/pinebook-pro-rk3399_defconfig.orig	2021-07-05 08:11:28.000000000 -0700
+++ configs/pinebook-pro-rk3399_defconfig	2021-07-25 14:05:30.629973309 -0700
@@ -3,6 +3,7 @@
 CONFIG_SYS_TEXT_BASE=0x00200000
 CONFIG_NR_DRAM_BANKS=1
 CONFIG_ENV_SIZE=0x8000
+CONFIG_SYS_MMCSD_RAW_MODE_U_BOOT_SECTOR=0x200
 CONFIG_DEFAULT_DEVICE_TREE="rk3399-pinebook-pro"
 CONFIG_ROCKCHIP_RK3399=y
 CONFIG_TARGET_PINEBOOK_PRO_RK3399=y
```

## sysutils/u-boot/patches-2021.07/patch-configs_rock64-rk3328_defconfig
```kconfig
$NetBSD: patch-configs_rock64-rk3328_defconfig,v 1.1 2021/07/26 06:36:41 mrg Exp $

Load u-boot from 256KB.

--- configs/rock64-rk3328_defconfig.orig	2021-04-05 08:03:29.000000000 -0700
+++ configs/rock64-rk3328_defconfig	2021-05-08 00:27:17.257028102 -0700
@@ -1,5 +1,6 @@
 CONFIG_ARM=y
 CONFIG_ARCH_ROCKCHIP=y
+CONFIG_SYS_MMCSD_RAW_MODE_U_BOOT_SECTOR=0x200
 CONFIG_SYS_TEXT_BASE=0x00200000
 CONFIG_SPL_GPIO_SUPPORT=y
 CONFIG_NR_DRAM_BANKS=1
```

## sysutils/u-boot/patches-2021.07/patch-configs_rockpro64-rk3399_defconfig
```kconfig
$NetBSD: patch-configs_rockpro64-rk3399_defconfig,v 1.1 2021/07/26 06:36:41 mrg Exp $

Load u-boot from 256KB.
Enable AHCI and Silicon Image PCIe SATA controllers.

--- configs/rockpro64-rk3399_defconfig.orig	2021-04-26 17:53:51.000000000 -0700
+++ configs/rockpro64-rk3399_defconfig	2021-05-22 16:09:08.812523859 -0700
@@ -1,5 +1,6 @@
 CONFIG_ARM=y
 CONFIG_ARCH_ROCKCHIP=y
+CONFIG_SYS_MMCSD_RAW_MODE_U_BOOT_SECTOR=0x200
 CONFIG_SYS_TEXT_BASE=0x00200000
 CONFIG_NR_DRAM_BANKS=1
 CONFIG_ENV_SIZE=0x8000
@@ -62,6 +63,13 @@
 CONFIG_DEBUG_UART_SHIFT=2
 CONFIG_ROCKCHIP_SPI=y
 CONFIG_SYSRESET=y
+CONFIG_AHCI=y
+CONFIG_AHCI_PCI=y
+CONFIG_SATA=y
+CONFIG_SATA_SIL=y
+CONFIG_SCSI=y
+CONFIG_SCSI_AHCI=y
+CONFIG_DM_SCSI=y
 CONFIG_USB=y
 CONFIG_USB_XHCI_HCD=y
 CONFIG_USB_XHCI_DWC3=y
```

## sysutils/u-boot/patches-2022.01/patch-configs_nanopi-r2s-rk3328_defconfig
```kconfig
$NetBSD: patch-configs_nanopi-r2s-rk3328_defconfig,v 1.2 2023/08/27 23:38:07 gutteridge Exp $

Load u-boot from 256KB.

--- configs/nanopi-r2s-rk3328_defconfig.orig	2022-01-10 13:46:34.000000000 -0500
+++ configs/nanopi-r2s-rk3328_defconfig
@@ -1,6 +1,7 @@
 CONFIG_ARM=y
 CONFIG_SKIP_LOWLEVEL_INIT=y
 CONFIG_ARCH_ROCKCHIP=y
+CONFIG_SYS_MMCSD_RAW_MODE_U_BOOT_SECTOR=0x200
 CONFIG_SYS_TEXT_BASE=0x00200000
 CONFIG_SPL_GPIO=y
 CONFIG_NR_DRAM_BANKS=1
```

## sysutils/u-boot/patches-2022.01/patch-configs_pinebook-pro-rk3399_defconfig
```kconfig
$NetBSD: patch-configs_pinebook-pro-rk3399_defconfig,v 1.2 2022/02/12 07:44:55 mrg Exp $

Load u-boot from 256KB, and environment from 4MB-32KB.

--- configs/pinebook-pro-rk3399_defconfig.orig	2022-01-10 12:46:34.000000000 -0600
+++ configs/pinebook-pro-rk3399_defconfig	2022-02-11 19:07:48.402914218 -0600
@@ -4,6 +4,8 @@
 CONFIG_SYS_TEXT_BASE=0x00200000
 CONFIG_NR_DRAM_BANKS=1
 CONFIG_ENV_SIZE=0x8000
+CONFIG_ENV_OFFSET=0x3F8000
+CONFIG_SYS_MMCSD_RAW_MODE_U_BOOT_SECTOR=0x200
 CONFIG_DEFAULT_DEVICE_TREE="rk3399-pinebook-pro"
 CONFIG_ROCKCHIP_RK3399=y
 CONFIG_TARGET_PINEBOOK_PRO_RK3399=y
```

## sysutils/u-boot/patches-2022.01/patch-configs_rock64-rk3328_defconfig
```kconfig
$NetBSD: patch-configs_rock64-rk3328_defconfig,v 1.1 2022/02/11 21:46:14 mrg Exp $

Load u-boot from 256KB.

--- configs/rock64-rk3328_defconfig.orig	2022-01-10 10:46:34.000000000 -0800
+++ configs/rock64-rk3328_defconfig	2022-02-07 02:26:32.821429380 -0800
@@ -1,6 +1,7 @@
 CONFIG_ARM=y
 CONFIG_SKIP_LOWLEVEL_INIT=y
 CONFIG_ARCH_ROCKCHIP=y
+CONFIG_SYS_MMCSD_RAW_MODE_U_BOOT_SECTOR=0x200
 CONFIG_SYS_TEXT_BASE=0x00200000
 CONFIG_SPL_GPIO=y
 CONFIG_NR_DRAM_BANKS=1
```

## sysutils/u-boot/patches-2022.01/patch-configs_rockpro64-rk3399_defconfig
```kconfig
$NetBSD: patch-configs_rockpro64-rk3399_defconfig,v 1.1 2022/02/11 21:46:14 mrg Exp $

Load u-boot from 256KB.
Enable AHCI and Silicon Image PCIe SATA controllers.

--- configs/rockpro64-rk3399_defconfig.orig	2022-01-10 10:46:34.000000000 -0800
+++ configs/rockpro64-rk3399_defconfig	2022-02-07 17:35:17.409379259 -0800
@@ -1,6 +1,7 @@
 CONFIG_ARM=y
 CONFIG_SKIP_LOWLEVEL_INIT=y
 CONFIG_ARCH_ROCKCHIP=y
+CONFIG_SYS_MMCSD_RAW_MODE_U_BOOT_SECTOR=0x200
 CONFIG_SYS_TEXT_BASE=0x00200000
 CONFIG_NR_DRAM_BANKS=1
 CONFIG_ENV_SIZE=0x8000
@@ -63,6 +64,13 @@
 CONFIG_DEBUG_UART_SHIFT=2
 CONFIG_ROCKCHIP_SPI=y
 CONFIG_SYSRESET=y
+CONFIG_AHCI=y
+CONFIG_AHCI_PCI=y
+CONFIG_SATA=y
+CONFIG_SATA_SIL=y
+CONFIG_SCSI=y
+CONFIG_SCSI_AHCI=y
+CONFIG_DM_SCSI=y
 CONFIG_USB=y
 CONFIG_USB_XHCI_HCD=y
 CONFIG_USB_XHCI_DWC3=y
```

## sysutils/u-boot/patches/patch-configs_A20-OLinuXino-Lime2-eMMC_defconfig
```kconfig
$NetBSD: patch-configs_A20-OLinuXino-Lime2-eMMC_defconfig,v 1.2 2019/09/05 16:09:09 bouyer Exp $

CONFIG_GMAC_TX_DELAY=4 required for lime2 boards with a Micrel PHY,
doesn't hurt for older ones (with the realtek PHY)

Add SPI flash support (for newer Lime2-eMMC boards)

--- configs/A20-OLinuXino-Lime2-eMMC_defconfig.orig	2018-11-14 17:10:06.000000000 +0100
+++ configs/A20-OLinuXino-Lime2-eMMC_defconfig	2019-09-05 16:38:07.781366370 +0200
@@ -10,9 +10,11 @@
 CONFIG_I2C1_ENABLE=y
 CONFIG_SATAPWR="PC3"
 CONFIG_AHCI=y
+CONFIG_GMAC_TX_DELAY=4
 CONFIG_NR_DRAM_BANKS=1
 # CONFIG_SYS_MALLOC_CLEAR_ON_INIT is not set
 CONFIG_SPL_I2C_SUPPORT=y
+CONFIG_SPL_SPI_SUNXI=y
 CONFIG_CMD_DFU=y
 # CONFIG_CMD_FLASH is not set
 CONFIG_CMD_USB_MASS_STORAGE=y
```

## sysutils/u-boot/patches/patch-configs_A20-OLinuXino-Lime2_defconfig
```kconfig
$NetBSD: patch-configs_A20-OLinuXino-Lime2_defconfig,v 1.1 2019/07/18 19:18:33 bouyer Exp $

CONFIG_GMAC_TX_DELAY=4 required for lime2 boards with a Micrel PHY,
doesn't hurt for older ones (with the realtek PHY)

--- configs/A20-OLinuXino-Lime2_defconfig.orig	2019-07-17 18:57:03.912432611 +0200
+++ configs/A20-OLinuXino-Lime2_defconfig	2019-07-17 18:59:35.091714198 +0200
@@ -9,6 +9,7 @@
 CONFIG_I2C1_ENABLE=y
 CONFIG_SATAPWR="PC3"
 CONFIG_AHCI=y
+CONFIG_GMAC_TX_DELAY=4
 CONFIG_NR_DRAM_BANKS=1
 # CONFIG_SYS_MALLOC_CLEAR_ON_INIT is not set
 CONFIG_SPL_I2C_SUPPORT=y
```

## sysutils/u-boot/patches/patch-configs_jetson-tk1_defconfig
```kconfig
$NetBSD: patch-configs_jetson-tk1_defconfig,v 1.1 2018/09/27 14:29:36 skrll Exp $
--- configs/jetson-tk1_defconfig.orig	2018-09-27 14:26:37.000000000 +0100
+++ configs/jetson-tk1_defconfig	2018-09-27 14:27:09.000000000 +0100
@@ -54,3 +54,4 @@
 CONFIG_USB_GADGET_DOWNLOAD=y
 CONFIG_USB_HOST_ETHER=y
 CONFIG_USB_ETHER_ASIX=y
+CONFIG_BOOTCOMMAND="pci enum; run distro_bootcmd"
```

## sysutils/u-boot/patches/patch-configs_p2371-2180_defconfig
```kconfig
$NetBSD: patch-configs_p2371-2180_defconfig,v 1.1 2018/09/25 21:49:20 jmcneill Exp $

--- configs/p2371-2180_defconfig.orig	2018-05-07 15:32:36.000000000 +0000
+++ configs/p2371-2180_defconfig
@@ -47,3 +47,4 @@ CONFIG_CI_UDC=y
 CONFIG_USB_GADGET_DOWNLOAD=y
 CONFIG_USB_HOST_ETHER=y
 CONFIG_USB_ETHER_ASIX=y
+CONFIG_BOOTCOMMAND="pci enum; run distro_bootcmd"
```
